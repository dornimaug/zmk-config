#include <behaviors.dtsi>
#include <dt-bindings/zmk/keys.h>
#include <dt-bindings/zmk/bt.h>
#include <dt-bindings/zmk/rgb.h>

#define ZMK_POINTING_DEFAULT_SCRL_VAL 15
#include <dt-bindings/zmk/pointing.h>

#include <dt-bindings/zmk/outputs.h>

#ifndef KEYMAP_DRAWER

#include "keys_de.h"

#endif // KEYMAP_DRAWER

#include "corne_choc_pro-labels.h"
#include "common.dtsi"

/ {
    chosen {
        zmk,physical-layout = &default_layout;
    };
};

&lt {
    tapping-term-ms = <280>; // default 200
    flavor = "balanced";
    quick-tap-ms = <200>;
};

&mt {
    tapping-term-ms = <280>; // default 200
    flavor = "balanced";
    quick-tap-ms = <200>;
};

// layers
#define QWERTZ          0
#define QWERTZ_UML      1
#define NUM_LEFT        2
#define NUM_RIGHT       3
#define SYMBOL          4
#define NAVI            5
#define FUNCTION        6
#define MOUSE           7
#define SYSTEM          8

/ {
    behaviors {
        // see https://github.com/zmkfirmware/zmk/issues/544
        // HOME_ROW_MOD(hml_skq, &kp, &skq, KEYS_RIGHT KEYS_THUMB)
        // HOME_ROW_MOD(hmr_skq, &kp, &skq, KEYS_LEFT KEYS_THUMB)
        // HOME_ROW_MOD(hml_sl, &kp, &sl, KEYS_RIGHT KEYS_THUMB)
        // HOME_ROW_MOD(hmr_sl, &kp, &sl, KEYS_LEFT KEYS_THUMB)

        MORPH(mute_mic_pp,  MUTE_MIC,   C_PP,       MOD_ANY)

        MORPH(qmark_dqt,    DE_QMARK,   DE_DQT,     MOD_LSFT|MOD_RSFT)
        MORPH(excl_sqt,     DE_EXCL,    DE_SQT,     MOD_LSFT|MOD_RSFT)
        MORPH(fslh_bslh,    DE_FSLH,    DE_BSLH,    MOD_LSFT|MOD_RSFT)

        HOME_ROW_MOD(hmr_qmark_dqt, &kp, &qmark_dqt,    KEYS_LEFT KEYS_THUMB)
        HOME_ROW_MOD(hml_mo,        &mo, &kp,           KEYS_RIGHT KEYS_THUMB)
    };

    macros {
        // Used by layer-listener to ensure toggled shift is turned off when leaving a layer
        reset_kt_mods: reset_kt_mods {
            compatible = "zmk,behavior-macro";
            #binding-cells = <0>;
            bindings 
                = <&kt_off LSHFT>
                , <&kt_off RSHFT>
                , <&kt_off RALT>;
        };
    };

    layer_listeners {
        // see https://github.com/ssbb/zmk-listeners/tree/v1
        compatible = "zmk,layer-listeners";

        reset_kt_mods_on_exit {
            layers = <NAVI NUM_LEFT MOUSE>;
            bindings = <&none &reset_kt_mods>;
        };
    };


    combos {
        compatible = "zmk,combos";

        // see https://github.com/zmkfirmware/zmk/issues/544
        // COMBO_ROLL(cc_combo_home_bspc,     LM2 LM3, &hml LS(LCTRL) BSPC,   QWERTZ QWERTZ_UML COLEMAK COLEMAK_UML)   // qwertz df

        // if we ever want to go back to shift combos on home row mods
        // COMBO_ROLL(cc_combo_sshft_l1,  LM3 LM2, &hml_skq LS(LCTRL) LSHFT,  COLEMAK BUT)  // qwertz df
        // COMBO_ROLL(cc_combo_sshft_l2,  LM5 LM4, &hml_skq LG(LALT) LSHFT,   COLEMAK BUT)  // qwertz as
        // COMBO_ROLL(cc_combo_sshft_r,   RM2 RM3, &hmr_skq RS(RCTRL) RSHFT,  COLEMAK BUT)  // qwertz jk

        COMBO_ROLL(cc_combo_fslh, RB3 RB4, &fslh_bslh, QWERTZ QWERTZ_UML)
        
        COMBO_UMLAUT(cc_combo_qw_u_uml, RT2 RM5, DE_U_UMLAUT, QWERTZ)
        COMBO_UMLAUT(cc_combo_qw_o_uml, RT4 RM5, DE_O_UMLAUT, QWERTZ)
        COMBO_UMLAUT(cc_combo_qw_a_uml, LM5 RM5, DE_A_UMLAUT, QWERTZ)
        COMBO_UMLAUT(cc_combo_qw_sz,    LM4 RM5, DE_SZ,       QWERTZ)

        // same side toggles for layers for one-hand-access
        COMBO_LAYER_TOG(cc_combo_mouse_tog,     LH0 LT0, MOUSE,         QWERTZ QWERTZ_UML MOUSE)
        COMBO_LAYER_TOG(cc_combo_num_l_tog,     LH0 LM0, NUM_LEFT,      QWERTZ QWERTZ_UML NUM_LEFT)
        COMBO_LAYER_TOG(cc_combo_num_r_tog,     RH0 RT0, NUM_RIGHT,     QWERTZ QWERTZ_UML NUM_RIGHT)
        COMBO_LAYER_TOG(cc_combo_navi_tog,      RH0 RM0, NAVI,          QWERTZ QWERTZ_UML NAVI)
    };
};

#define XXX &none  
#define ___ &trans

#define LEFT_ACTIVATE_TOP       &kp REDO_    &kp TAB  &kp RET   &kp SPC    &kp UNDO_
#define LEFT_ACTIVATE_MIDDLE    &kp LGUI     &kp LALT &kp LCTL  &kp LSHFT  &kp BSPC
#define LEFT_ACTIVATE_BOTTOM    &kp LC(DE_A) &kp CUT_ &kp COPY_ &kp PASTE_ &kp DEL

#define RIGHT_ACTIVATE_TOP      &kp UNDO_ &kp SPC    &kp RET    &kp TAB  &kp REDO_    &kp ESC
#define RIGHT_ACTIVATE_MIDDLE   &kp BSPC  &kp RSHFT  &kp RCTL   &kp LALT &kp RGUI     &kp RALT
#define RIGHT_ACTIVATE_BOTTOM   &kp DEL   &kp PASTE_ &kp COPY_  &kp CUT_ &kp LC(DE_A) XXX

/ {
    keymap {
        compatible = "zmk,keymap";

        qwertz_layer {
            display-name = "QWERTZ";
            bindings = <
&kp ESC         &kp DE_Q       &kp DE_W       &kp DE_E        &kp DE_R                &kp DE_T   &mute_mic_pp /**/ &kp MAGIC  &kp DE_Z       &kp DE_U       &kp DE_I       &kp DE_O       &kp DE_P                     &excl_sqt
&lt SYMBOL TAB  &hml LGUI DE_A &hml LALT DE_S &hml LCTL DE_D  &hml LSHFT DE_F         &kp DE_G   &mt LCTL RET /**/ &kp BSPC   &hmr RALT DE_H &hmr RSFT DE_J &hmr RCTL DE_K &hmr LALT DE_L &mo_sl QWERTZ_UML QWERTZ_UML &hmr_qmark_dqt RGUI 0
&caps_word      &kp DE_Y       &kp DE_X       &kp DE_C        &hml_mo QWERTZ_UML DE_V &kp DE_B                                &kp DE_N       &kp DE_M       &kp DE_COMMA   &kp DE_DOT     &kp DE_MINUS                 &fslh_bslh
                                              &mo_sl SYMBOL SYMBOL &mo_skq NAVI LSHFT &lt NUM_RIGHT BSPC      /**/            &lt SYMBOL RET &lt NUM_RIGHT SPC &lt FUNCTION TAB
            >;
        };

        qwertz_umlauts_overlay_layer {
            display-name = "QWERTZ uml";
            bindings = <
___ ___              ___       ___ ___ ___ ___ /**/ ___ ___ &kp DE_U_UMLAUT ___ &kp DE_O_UMLAUT ___ ___
___ &kp DE_A_UMLAUT  &kp DE_SZ ___ ___ ___ ___ /**/ ___ ___ ___             ___ ___             &kp DE_SHARP_S &kp DE_A_UMLAUT
___ ___              ___       ___ ___ ___                  ___ ___         ___ ___             ___ ___
                               ___ ___ ___                  ___ ___         ___
            >;
        };

        number_left_layer {
            display-name = "num_l";
            bindings = <
&caret_nd     &kp DE_COLON  &kp DE_N7  &kp DE_N8  &kp DE_N9  &kp KP_MULTIPLY &kp DE_HASH  &kp C_AL_CALC RIGHT_ACTIVATE_TOP
&kp KP_DIVIDE &kp DE_DOT    &kp DE_N4  &kp DE_N5  &kp DE_N6  &kp KP_PLUS     &kp BSPC     &kp DE_EQUAL  RIGHT_ACTIVATE_MIDDLE
&kp DE_EURO   &kp DE_COMMA  &kp DE_N1  &kp DE_N2  &kp DE_N3  &kp KP_MINUS                               RIGHT_ACTIVATE_BOTTOM
                                       &kp TAB    &kp DE_N0  &mt LSHFT KP_ENTER                         XXX  XXX  XXX
            >;
        };

        number_right_layer {
            display-name = "num_r";
            // the number keys are not mirrored, only the symbol keys
            bindings = <
&kp ESC  LEFT_ACTIVATE_TOP     &kp C_AL_CALC &kp DE_HASH &kp KP_MULTIPLY    &kp DE_N7 &kp DE_N8 &kp DE_N9 &kp DE_COLON  &caret_nd
&kp RALT LEFT_ACTIVATE_MIDDLE  &kp DE_EQUAL  &kp BSPC    &kp KP_PLUS        &kp DE_N4 &kp DE_N5 &kp DE_N6 &kp DE_DOT    &kp KP_DIVIDE
XXX      LEFT_ACTIVATE_BOTTOM                            &kp KP_MINUS       &kp DE_N1 &kp DE_N2 &kp DE_N3 &kp DE_COMMA  &kp DE_EURO
                 XXX    XXX    XXX                       &mt RSHFT KP_ENTER &kp DE_N0 &kp TAB
            >;
        };

        symbol_layer {
            display-name = "symbol";
            bindings = <
&kp DE_DEG  &kp DE_AT   &kp DE_SQT   &kp DE_PLUS  &kp DE_DLLR  &kp DE_STAR  &mt LALT ESC &kp DEL  &kp DE_AMPS &kp DE_LBRC  &kp DE_RBRC &kp DE_SEMI  &kp DE_COLON &kp DE_ACUTE
&kp TAB     &kp DE_EXCL &kp DE_FSLH  &kp DE_EQUAL &kp DE_COLON &kp DE_HASH  &kp DEL      &kp BSPC &kp DE_PIPE &kp DE_LPAR  &kp DE_RPAR &kp DE_DQT   &kp DE_DOT   &kp DE_TILDE
&caret_nd   &kp DE_LT   &grave_nd    &kp DE_GT    &kp DE_MINUS &kp DE_PRCNT                       &kp DE_BSLH &kp DE_LBKT  &kp DE_RBKT &kp DE_UNDER &kp DE_COMMA &kp DE_QMARK
                                     &kp RET      &mt LCTL SPC &kp BSPC                           &kp RET     &mt LCTL SPC &kp TAB
            >;
        };

        navigation_layer {
            display-name = "navi";
            bindings = <
&kp ESC     LEFT_ACTIVATE_TOP     &kp C_PREV &kp C_NEXT &mkp MB4  &kp PG_UP    &kp UP    &kp PG_DN      &mkp MB5   &kp MUTE_MIC
&mo SYSTEM  LEFT_ACTIVATE_MIDDLE  &kp DEL    &kp BSPC   &kp HOME  &kp LEFT     &kp DOWN  &kp RIGHT      &kp END    &kp C_PP
&kt LSHFT   LEFT_ACTIVATE_BOTTOM                        &kp ESC   &msc SCRL_UP &kp DEL   &msc SCRL_DOWN &vol_dn_up &kp C_MUTE
                        XXX  XXX  XXX                   &kp RET   &kp SPC      &kp TAB
            >;
        };

        function_layer {
            display-name = "func";
            bindings = <
&kp ESC    &kp F12  &kp F7  &kp F8   &kp F9    &kp SS_WIN  &kp MUTE_MIC XXX  RIGHT_ACTIVATE_TOP
&kp CAPS   &kp F11  &kp F4  &kp F5   &kp F6    &kp SSS_WIN &kp COPILOT  XXX  RIGHT_ACTIVATE_MIDDLE
&caps_word &kp F10  &kp F1  &kp F2   &kp F3    &kp CSR_WIN                   RIGHT_ACTIVATE_BOTTOM
                            &kp CUT_ &kp COPY_ &kp PASTE_                    XXX  XXX  XXX   
            >;
        };

        mouse_layer {
            display-name = "mouse";
            bindings = <
XXX       &mkp MB3       &msc SCRL_UP    &mmv MOVE_UP   &msc SCRL_DOWN  &msc SCRL_UP    &kp MUTE_MIC XXX  RIGHT_ACTIVATE_TOP
XXX       &mkp MB2       &mmv MOVE_LEFT  &mmv MOVE_DOWN &mmv MOVE_RIGHT &msc SCRL_DOWN  XXX          XXX  RIGHT_ACTIVATE_MIDDLE
&kp LCTRL &msc SCRL_LEFT &msc SCRL_RIGHT &mkp MB5       &mkp MB4        &kp  DEL                          RIGHT_ACTIVATE_BOTTOM
                                         &mkp MB2       &mkp MB1        &mkp MB1                          XXX  XXX  XXX
            >;
        };
        
#define RGB_(k) &rgb_ug RGB_##k

        system_layer {
            display-name = "system";
            bindings = <
XXX  &bt BT_SEL 0  &bt BT_SEL 1  &bt BT_SEL 2  &bt BT_SEL 3   &bt BT_SEL 4   XXX            XXX  RGB_(EFF) RGB_(SAI)     RGB_(BRI)       RGB_(HUI)      XXX       XXX
XXX  &bt BT_DISC 0 &bt BT_DISC 1 &bt BT_DISC 2 &bt BT_DISC 3  &bt BT_DISC 4  &td_bootloader XXX  RGB_(EFR) RGB_(SAD)     RGB_(BRD)       RGB_(HUD)      RGB_(TOG) XXX
XXX  &out OUT_TOG  &td_sys_reset &td_bt_clr    &studio_unlock &td_bootloader                     XXX       RGB_(COL_RED) RGB_(COL_GREEN) RGB_(COL_BLUE) XXX       XXX 
                                 XXX           XXX            XXX                                XXX       XXX           XXX  
            >;
        };

#undef RGB_

    };
};
