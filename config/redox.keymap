#include <behaviors.dtsi>
#include <dt-bindings/zmk/keys.h>
#include <dt-bindings/zmk/bt.h>
#include <dt-bindings/zmk/ext_power.h>
#include <dt-bindings/zmk/outputs.h>

#define ZMK_POINTING_DEFAULT_SCRL_VAL 15
#include <dt-bindings/zmk/pointing.h>

#ifndef KEYMAP_DRAWER
#include "keys_de.h"
#endif // KEYMAP_DRAWER

#include "redox-labels.h"
#include "common.dtsi"

&lt {
    tapping-term-ms = <280>; // default 200
    flavor = "balanced";
    quick-tap-ms = <200>;
};

&mt {
    tapping-term-ms = <280>; // default 200
    flavor = "balanced";
    quick-tap-ms = <200>;
};

// layers
#define QWERTZ          0
#define QWERTZ_UML      1
#define NUM_LEFT        2
#define NUM_RIGHT       3
#define SYMBOL          4
#define NAVI            5
#define FUNCTION        6
#define MOUSE           7
#define SYSTEM          8

/ {
    behaviors {
        // see https://github.com/zmkfirmware/zmk/issues/544
        // HOME_ROW_MOD(hml_skq, &kp, &skq, KEYS_RIGHT KEYS_THUMB)
        // HOME_ROW_MOD(hmr_skq, &kp, &skq, KEYS_LEFT KEYS_THUMB)
        // HOME_ROW_MOD(hml_sl, &kp, &sl, KEYS_RIGHT KEYS_THUMB)
        // HOME_ROW_MOD(hmr_sl, &kp, &sl, KEYS_LEFT KEYS_THUMB)

        MORPH(mute_mic_pp,  MUTE_MIC,   C_PP,       MOD_ANY)

        MORPH(qmark_dqt,    DE_QMARK,   DE_DQT,     MOD_LSFT|MOD_RSFT)
        MORPH(excl_sqt,     DE_EXCL,    DE_SQT,     MOD_LSFT|MOD_RSFT)
        MORPH(fslh_bslh,    DE_FSLH,    DE_BSLH,    MOD_LSFT|MOD_RSFT)

        HOME_ROW_MOD(hmr_qmark_dqt, &kp, &qmark_dqt,    KEYS_LEFT KEYS_THUMB)
        HOME_ROW_MOD(hmr_fslh_bslh, &kp, &fslh_bslh,    KEYS_LEFT KEYS_THUMB)
        HOME_ROW_MOD(hml_mo,        &mo, &kp,           KEYS_RIGHT KEYS_THUMB)

        TAP_DANCE_2(td_caps_word_lock, &caps_word, &kp CAPS)
    };

    macros {
        // Used by layer-listener to ensure toggled shift is turned off when leaving a layer
        reset_kt_mods: reset_kt_mods {
            compatible = "zmk,behavior-macro";
            #binding-cells = <0>;
            bindings 
                = <&kt_off LSHFT>
                , <&kt_off RSHFT>
                , <&kt_off RALT>;
        };
    };

    layer_listeners {
        // see https://github.com/ssbb/zmk-listeners/tree/v1
        compatible = "zmk,layer-listeners";

        reset_kt_mods_on_exit {
            layers = <NAVI NUM_LEFT NUM_RIGHT SYMBOL MOUSE>;
            bindings = <&none &reset_kt_mods>;
        };
    };


    combos {
        compatible = "zmk,combos";

        // see https://github.com/zmkfirmware/zmk/issues/544
        // COMBO_ROLL(rdx_combo_home_bspc,     LM2 LM3, &hml LS(LCTRL) BSPC,   QWERTZ QWERTZ_UML COLEMAK COLEMAK_UML)   // qwertz df

        // if we ever want to go back to shift combos on home row mods
        // COMBO_ROLL(rdx_combo_sshft_l1,  LM3 LM2, &hml_skq LS(LCTRL) LSHFT,  COLEMAK BUT)  // qwertz df
        // COMBO_ROLL(rdx_combo_sshft_l2,  LM5 LM4, &hml_skq LG(LALT) LSHFT,   COLEMAK BUT)  // qwertz as
        // COMBO_ROLL(rdx_combo_sshft_r,   RM2 RM3, &hmr_skq RS(RCTRL) RSHFT,  COLEMAK BUT)  // qwertz jk

        COMBO_ROLL(rdx_combo_fslh,  RB3 RB4, &fslh_bslh, QWERTZ QWERTZ_UML)
        COMBO_ROLL(rdx_combo_home,  RF3 RF4, &kp HOME,   QWERTZ QWERTZ_UML)
        COMBO_ROLL(rdx_combo_end,   RF4 RF5, &kp END,    QWERTZ QWERTZ_UML)
        
        COMBO_UMLAUT(rdx_combo_qw_u_uml, RT2 RM5, DE_U_UMLAUT, QWERTZ)
        COMBO_UMLAUT(rdx_combo_qw_o_uml, RT4 RM5, DE_O_UMLAUT, QWERTZ)
        COMBO_UMLAUT(rdx_combo_qw_a_uml, LM5 RM5, DE_A_UMLAUT, QWERTZ)
        COMBO_UMLAUT(rdx_combo_qw_sz,    LM4 RM5, DE_SZ,       QWERTZ)

        // same side toggles for layers for one-hand-access
        COMBO_LAYER_TOG(rdx_combo_mouse_tog,    LH0 LM0, MOUSE,         QWERTZ QWERTZ_UML MOUSE)
        COMBO_LAYER_TOG(rdx_combo_num_l_tog,    LH1 LM0, NUM_LEFT,      QWERTZ QWERTZ_UML NUM_LEFT)

        COMBO_LAYER_TOG(rdx_combo_num_r_tog,    RH0 RM0, NUM_RIGHT,     QWERTZ QWERTZ_UML NUM_RIGHT)
        COMBO_LAYER_TOG(rdx_combo_navi_tog,     RH1 RM0, NAVI,          QWERTZ QWERTZ_UML NAVI)

        COMBO_THUMB(rdx_combo_symb_r_hold,  LH1 LH4, &mo SYMBOL,        QWERTZ QWERTZ_UML)
        COMBO_THUMB(rdx_combo_func_hold,    RH1 RH4, &mo FUNCTION,      QWERTZ QWERTZ_UML)
    };
};

#define XXX &none  
#define ___ &trans

#define LEFT_ACTIVATE_TOP      &kp REDO_    &kp TAB   &kp RET   &kp SPC    &kp UNDO_
#define LEFT_ACTIVATE_MIDDLE   &kp LGUI     &kp LALT  &kp LCTRL &kp LSHFT  &kp BSPC
#define LEFT_ACTIVATE_BOTTOM   &kp LC(DE_A) &kp CUT_  &kp COPY_ &kp PASTE_ &kp DEL

#define RIGHT_ACTIVATE_TOP      &kp UNDO_ &kp SPC    &kp RET    &kp TAB   &kp REDO_    &kp ESC
#define RIGHT_ACTIVATE_MIDDLE   &kp BSPC  &kp LSHFT  &kp RCTRL  &kp LALT  &kp RGUI     &kp RALT
#define RIGHT_ACTIVATE_BOTTOM   &kp DEL   &kp PASTE_ &kp COPY_  &kp CUT_  &kp LC(DE_A) XXX

#define EMPTY_NUMBER_ROW    XXX XXX XXX XXX XXX XXX
#define EMPTY_4             XXX XXX XXX XXX

/ {
    keymap {
        compatible =  "zmk,keymap" ;

        qwertz_layer {
            display-name = "QWERTZ";
            bindings = <
&kp LSHFT      &kp DE_N1      &kp DE_N2      &kp DE_N3       &kp DE_N4               &kp DE_N5                                                                    &kp DE_N6      &kp DE_N7       &kp DE_N8      &kp DE_N9      &kp DE_N0                    &mute_mic_pp
&kp ESC        &kp DE_Q       &kp DE_W       &kp DE_E        &kp DE_R                &kp DE_T  &mute_mic_pp                                           &kp MAGIC   &kp DE_Z       &kp DE_U        &kp DE_I       &kp DE_O       &kp DE_P                     &excl_sqt
&lt SYMBOL TAB &hml LGUI DE_A &hml LALT DE_S &hml LCTL DE_D  &hml LSHFT DE_F         &kp DE_G  &mt LCTL RET                                           &kp BSPC    &hmr RALT DE_H &hmr RSHFT DE_J &hmr RCTL DE_K &hmr LALT DE_L &mo_sl QWERTZ_UML QWERTZ_UML &hmr_qmark_dqt RGUI 0
&caps_word     &kp DE_Y       &kp DE_X       &kp DE_C        &hml_mo QWERTZ_UML DE_V &kp DE_B  &kp SPC         &mt RALT RET          &kp ESC          &kp DEL     &kp DE_N       &kp DE_M        &kp COMMA      &kp DE_DOT     &kp DE_MINUS                 &fslh_bslh
&kp LCTRL      &kp LALT       &kp LGUI       &mt RALT ESC           &mo_skq NAVI LSHFT      &lt NUM_RIGHT BSPC &mo_sl SYMBOL SYMBOL  &lt FUNCTION TAB &lt SYMBOL RET     &lt NUM_RIGHT SPC        &kp LEFT       &kp RIGHT      &kp DOWN                     &kp UP
            >;

        };

        qwertz_umlauts_overlay_layer {
            display-name = "QWERTZ uml";
            bindings = <
___ ___              ___       ___ ___ ___                      ___ ___             ___ ___             ___ ___
___ ___              ___       ___ ___ ___ ___     /**/     ___ ___ &kp DE_U_UMLAUT ___ &kp DE_O_UMLAUT ___ ___
___ &kp DE_A_UMLAUT  &kp DE_SZ ___ ___ ___ ___     /**/     ___ ___ ___             ___ ___             &kp DE_SHARP_S &kp DE_A_UMLAUT
___ ___              ___       ___ ___ ___ ___ ___      ___ ___ ___ ___             ___ ___             ___ ___
___ ___              ___       ___   ___   ___ ___      ___ ___   ___               ___ ___             ___ ___
            >;
        };

        number_left_layer {
            display-name = "num_l";
            bindings = <
&kp C_AL_CALC       &kp KP_NUM       &kp DE_LT   &kp DE_GT    &kp DE_PRCNT &kp DE_HASH                                                   EMPTY_NUMBER_ROW
&caret_nd           &kp DE_COLON     &kp DE_N7   &kp DE_N8    &kp DE_N9    &kp KP_MULTIPLY &kp DE_EQUAL                    &kp C_AL_CALC RIGHT_ACTIVATE_TOP
&kp KP_DIVIDE       &kp DE_DOT       &kp DE_N4   &kp DE_N5    &kp DE_N6    &kp KP_PLUS     &kp BSPC                        &kp DE_HASH   RIGHT_ACTIVATE_MIDDLE
&kp DE_EURO         &kp DE_COMMA     &kp DE_N1   &kp DE_N2    &kp DE_N3    &kp KP_MINUS    &kp ESC            &kp SPC  XXX XXX           RIGHT_ACTIVATE_BOTTOM
&mt_sk LSHFT LSHFT  &mt_sk RALT RALT &kp KP_DOT  &kp RET               &kp DE_N0           &mt LSHFT KP_ENTER &kp TAB  XXX XXX           XXX EMPTY_4
            >;
        };

        number_right_layer {
            display-name = "num_r";
            // numbers and symbols not mirrored, only thumb, inner and outer keys
            bindings = <
EMPTY_NUMBER_ROW                                                          &kp DE_HASH     &kp DE_PRCNT &kp DE_LT    &kp DE_GT   &kp KP_NUM       &kp C_AL_CALC    
&kp ESC  LEFT_ACTIVATE_TOP     &kp C_AL_CALC            &kp DE_HASH       &kp KP_MULTIPLY &kp DE_N7    &kp DE_N8    &kp DE_N9   &kp DE_COLON     &caret_nd
&kp RALT LEFT_ACTIVATE_MIDDLE  &kp DE_EQUAL             &kp BSPC          &kp KP_PLUS     &kp DE_N4    &kp DE_N5    &kp DE_N6   &kp DE_DOT       &kp KP_DIVIDE
XXX      LEFT_ACTIVATE_BOTTOM  XXX      XXX    &kp SPC  &kp ESC           &kp KP_MINUS    &kp DE_N1    &kp DE_N2    &kp DE_N3   &kp DE_COMMA     &kp DE_EURO
EMPTY_4             XXX        XXX      XXX    &kp TAB  &mt RSHFT KP_ENTER         &kp DE_N0           &kp RET      &kp KP_DOT  &mt_sk RALT RALT &mt_sk RSHFT RSHFT
            >;
        };

        symbol_layer {
            display-name = "symbol";
            bindings = <
&kp ESC     &kp DE_SUPER2 &kp DE_SUPER3 &kp DE_SECT  XXX          XXX                                             &kp DE_DEG   XXX         XXX         &kp DE_MICRO &kp DE_ACUTE &kp ESC
&kp DE_DEG  &kp DE_AT     &kp DE_SQT    &kp DE_PLUS  &kp DE_DLLR  &kp DE_STAR  &mt LALT ESC              &kp DEL  &kp DE_AMPS  &kp DE_LBRC &kp DE_RBRC &kp DE_SEMI  &kp DE_COLON &kp DE_ACUTE
&kp TAB     &kp DE_EXCL   &kp DE_FSLH   &kp DE_EQUAL &kp DE_COLON &kp DE_HASH  &kp DEL                   &kp BSPC &kp DE_PIPE  &kp DE_LPAR &kp DE_RPAR &kp DE_DQT   &kp DE_DOT   &kp DE_TILDE
&caret_nd   &kp DE_LT     &grave_nd     &kp DE_GT    &kp DE_MINUS &kp DE_PRCNT &kp DEL  &kp TAB  &kp RET &kp DEL  &kp DE_BSLH  &kp DE_LBKT &kp DE_RBKT &kp DE_UNDER &kp DE_COMMA &kp DE_QMARK
&kp LCTRL   &kp LALT      &kp LEFT      &kp RIGHT         &mt LCTRL SPC        &kp BSPC &kp RET  &kp TAB &kp RET       &mt LCTRL SPC       &kp LEFT    &kp RIGHT    &kp LALT     &kp RCTRL
            >;
        };

        navigation_layer {
            display-name = "navi";
            bindings = <
EMPTY_NUMBER_ROW                                                     &kp PSCRN  &kp C_RW     &kp C_PP   &kp C_FF       &kp PAUSE_BREAK &kp BSPC
&kp ESC     LEFT_ACTIVATE_TOP     &kp C_PREV              &kp C_NEXT &mkp MB4   &kp PG_UP    &kp UP     &kp PG_DN      &mkp MB5        &kp MUTE_MIC
&mo SYSTEM  LEFT_ACTIVATE_MIDDLE  &kp DEL                 &kp BSPC   &kp HOME   &kp LEFT     &kp DOWN   &kp RIGHT      &kp END         &kp C_PP
&kt LSHFT   LEFT_ACTIVATE_BOTTOM  XXX        XXX  &kp DEL &kp K_APP  &kp ESC    &msc SCRL_UP &kp DEL    &msc SCRL_DOWN &vol_dn_up      &kp C_MUTE
EMPTY_4                    XXX    XXX        XXX  &kp TAB &kp RET          &kp SPC           &kp C_PREV &kp C_NEXT     &kp C_VOL_DN    &kp C_VOL_UP
            >;
        };

        function_layer {
            display-name = "func";
            bindings = <
&kp F13    &kp F14  &kp F15 &kp F16  &kp F17  &kp F18                                    &kp F19 &kp F20 &kp F21 &kp F22 &kp F23 &kp F24
&kp ESC    &kp F12  &kp F7  &kp F8   &kp F9   &kp SS_WIN  &kp MUTE_MIC              XXX  RIGHT_ACTIVATE_TOP
&kp CAPS   &kp F11  &kp F4  &kp F5   &kp F6   &kp SSS_WIN &kp COPILOT               XXX  RIGHT_ACTIVATE_MIDDLE
&caps_word &kp F10  &kp F1  &kp F2   &kp F3   &kp CSR_WIN &kp UNDO_ &kp REDO_  XXX  XXX  RIGHT_ACTIVATE_BOTTOM
EMPTY_4                                 &kp CUT_          &kp COPY_ &kp PASTE_ XXX  XXX     XXX    EMPTY_4
            >;
        };

        mouse_layer {
            display-name = "mouse";
            bindings = <
&tog MOUSE  XXX            XXX             XXX            XXX             XXX                                        EMPTY_NUMBER_ROW
XXX         &mkp MB3       &msc SCRL_UP    &mmv MOVE_UP   &msc SCRL_DOWN  &msc SCRL_UP    &kp MUTE_MIC          XXX  RIGHT_ACTIVATE_TOP
XXX         &mkp MB2       &mmv MOVE_LEFT  &mmv MOVE_DOWN &mmv MOVE_RIGHT &msc SCRL_DOWN  XXX                   XXX  RIGHT_ACTIVATE_MIDDLE
XXX         &msc SCRL_LEFT &msc SCRL_RIGHT &mkp MB5       &mkp MB4        &kp  DEL        &mkp MB5 &mkp MB4 XXX XXX  RIGHT_ACTIVATE_BOTTOM
EMPTY_4                                                              &mkp MB1             &mkp MB1 &mkp MB2 XXX XXX  XXX EMPTY_4
            >;
        };
    
        system_layer {
            display-name = "system";
            bindings = <
EMPTY_NUMBER_ROW                                                                                        EMPTY_NUMBER_ROW
XXX  &bt BT_SEL 0  &bt BT_SEL 1  &bt BT_SEL 2  &bt BT_SEL 3   &bt BT_SEL 4   &studio_unlock         XXX EMPTY_NUMBER_ROW
XXX  &bt BT_DISC 0 &bt BT_DISC 1 &bt BT_DISC 2 &bt BT_DISC 3  &bt BT_DISC 4  &td_bootloader         XXX EMPTY_NUMBER_ROW
XXX  &out OUT_TOG  &td_sys_reset &td_bt_clr    &td_bootloader &td_bootloader XXX            XXX XXX XXX EMPTY_NUMBER_ROW
EMPTY_4                                                     XXX              XXX            XXX XXX XXX    XXX   EMPTY_4
            >;
        };
    };
};
